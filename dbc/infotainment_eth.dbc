VERSION ""

NS_ :

BS_:

BU_: HEAD_UNIT CLUSTER TCU AMP NAV ADAS_DOM GW_CENTRAL

BO_ 4104 HEAD_UNIT_Status1: 64 HEAD_UNIT
 SG_ ClimateTouchReq : 0|4@1+ (1,0) [0|15] "" GW_CENTRAL,AMP
 SG_ ScreenTemp_Avg : 4|8@1+ (1,-40) [-40|215] "degC" GW_CENTRAL,ADAS_DOM,AMP
 SG_ MediaPos_Raw : 12|16@1+ (0.1,0) [0|6553.5] "s" GW_CENTRAL,AMP
 SG_ PhoneConnected : 28|1@1+ (1,0) [0|1] "" TCU,NAV,AMP
 SG_ ScreenTemp : 29|8@1+ (1,-40) [-40|215] "degC" AMP,ADAS_DOM
 SG_ Volume_Max : 37|8@1+ (0.4,0) [0|102] "%" AMP,NAV
 SG_ AliveCnt : 45|4@1+ (1,0) [0|15] "" AMP,NAV
 SG_ Crc8 : 49|8@1+ (1,0) [0|255] "" AMP,NAV

BO_ 4106 HEAD_UNIT_Data2: 64 HEAD_UNIT
 SG_ Volume_Raw : 0|8@1+ (0.4,0) [0|102] "%" TCU,GW_CENTRAL,AMP
 SG_ Source : 8|4@1+ (1,0) [0|15] "" GW_CENTRAL,TCU,AMP
 SG_ Brightness_Max : 12|8@1+ (0.4,0) [0|102] "%" GW_CENTRAL,AMP
 SG_ ScreenTemp_Raw : 20|8@1+ (1,-40) [-40|215] "degC" TCU,GW_CENTRAL,AMP
 SG_ Brightness_Min : 28|8@1+ (0.4,0) [0|102] "%" TCU,AMP
 SG_ Volume_Min : 36|8@1+ (0.4,0) [0|102] "%" GW_CENTRAL,NAV,TCU,AMP
 SG_ MediaPos_Max : 44|16@1+ (0.1,0) [0|6553.5] "s" NAV,AMP,CLUSTER
 SG_ Volume : 60|8@1+ (0.4,0) [0|102] "%" CLUSTER,AMP
 SG_ MediaPos_Min : 68|16@1+ (0.1,0) [0|6553.5] "s" AMP,GW_CENTRAL
 SG_ CameraView : 84|4@1+ (1,0) [0|15] "" ADAS_DOM,CLUSTER,AMP
 SG_ Brightness_Raw : 88|8@1+ (0.4,0) [0|102] "%" GW_CENTRAL,TCU,CLUSTER,AMP
 SG_ AliveCnt : 96|4@1+ (1,0) [0|15] "" AMP,TCU
 SG_ Crc8 : 100|8@1+ (1,0) [0|255] "" AMP,TCU

BO_ 4114 HEAD_UNIT_Cmd3: 64 HEAD_UNIT
 SG_ ScreenTemp_Max : 0|8@1+ (1,-40) [-40|215] "degC" AMP,GW_CENTRAL,CLUSTER
 SG_ NavActive : 8|1@1+ (1,0) [0|1] "" CLUSTER,AMP
 SG_ MediaPos : 9|16@1+ (0.1,0) [0|6553.5] "s" GW_CENTRAL,TCU,AMP,CLUSTER
 SG_ VoiceActive : 25|1@1+ (1,0) [0|1] "" TCU,AMP,CLUSTER
 SG_ Volume_Avg : 26|8@1+ (0.4,0) [0|102] "%" ADAS_DOM,CLUSTER
 SG_ Brightness_Avg : 34|8@1+ (0.4,0) [0|102] "%" TCU,CLUSTER
 SG_ MediaPos_Avg : 42|16@1+ (0.1,0) [0|6553.5] "s" AMP,GW_CENTRAL,CLUSTER
 SG_ ScreenTemp_Min : 58|8@1+ (1,-40) [-40|215] "degC" AMP,CLUSTER
 SG_ AliveCnt : 66|4@1+ (1,0) [0|15] "" CLUSTER
 SG_ Crc8 : 70|8@1+ (1,0) [0|255] "" CLUSTER

BO_ 4119 HEAD_UNIT_Info4: 64 HEAD_UNIT
 SG_ Brightness : 0|8@1+ (0.4,0) [0|102] "%" CLUSTER,ADAS_DOM,GW_CENTRAL
 SG_ AliveCnt : 8|4@1+ (1,0) [0|15] "" GW_CENTRAL,ADAS_DOM,CLUSTER,TCU
 SG_ Crc8 : 12|8@1+ (1,0) [0|255] "" GW_CENTRAL,ADAS_DOM,CLUSTER,TCU

BO_ 4126 HEAD_UNIT_Limits5: 64 HEAD_UNIT
 SG_ AliveCnt : 0|4@1+ (1,0) [0|15] "" GW_CENTRAL,ADAS_DOM,CLUSTER,TCU
 SG_ Crc8 : 4|8@1+ (1,0) [0|255] "" GW_CENTRAL,ADAS_DOM,CLUSTER,TCU

BO_ 4129 CLUSTER_Status1: 64 CLUSTER
 SG_ TripDist_Avg : 0|16@1+ (0.01,0) [0|655.35] "m" HEAD_UNIT,ADAS_DOM,TCU
 SG_ WarningLampAirbag : 16|1@1+ (1,0) [0|1] "" GW_CENTRAL,HEAD_UNIT,TCU
 SG_ UnitsMetric : 17|1@1+ (1,0) [0|1] "" AMP,TCU,ADAS_DOM
 SG_ GaugeNeedle_Raw : 18|16@1+ (0.1,-1000) [-1000|5553.5] "deg" TCU
 SG_ ClusterBrightness_Raw : 34|8@1+ (0.4,0) [0|102] "%" ADAS_DOM,GW_CENTRAL,TCU
 SG_ RangeEst_Max : 42|16@1+ (0.01,0) [0|655.35] "m" ADAS_DOM,NAV,TCU
 SG_ ClusterBrightness_Min : 58|8@1+ (0.4,0) [0|102] "%" NAV,AMP,TCU
 SG_ GaugeNeedle_Max : 66|16@1+ (0.1,-1000) [-1000|5553.5] "deg" ADAS_DOM,NAV,TCU
 SG_ ThemeId : 82|4@1+ (1,0) [0|15] "" HEAD_UNIT,TCU
 SG_ AliveCnt : 86|4@1+ (1,0) [0|15] "" TCU,HEAD_UNIT
 SG_ Crc8 : 90|8@1+ (1,0) [0|255] "" TCU,HEAD_UNIT

BO_ 4134 CLUSTER_Data2: 64 CLUSTER
 SG_ TripDist_Min : 0|16@1+ (0.01,0) [0|655.35] "m" NAV,GW_CENTRAL
 SG_ GaugeNeedle : 16|16@1+ (0.1,-1000) [-1000|5553.5] "deg" NAV,GW_CENTRAL
 SG_ WarningLampEng : 32|1@1+ (1,0) [0|1] "" NAV,GW_CENTRAL,ADAS_DOM
 SG_ WarningLampBatt : 33|1@1+ (1,0) [0|1] "" ADAS_DOM,NAV,GW_CENTRAL
 SG_ RangeEst_Avg : 34|16@1+ (0.01,0) [0|655.35] "m" TCU,GW_CENTRAL
 SG_ TripDist_Max : 50|16@1+ (0.01,0) [0|655.35] "m" AMP,GW_CENTRAL
 SG_ ClusterBrightness_Avg : 66|8@1+ (0.4,0) [0|102] "%" NAV,GW_CENTRAL
 SG_ AliveCnt : 74|4@1+ (1,0) [0|15] "" GW_CENTRAL,TCU,ADAS_DOM,HEAD_UNIT
 SG_ Crc8 : 78|8@1+ (1,0) [0|255] "" GW_CENTRAL,TCU,ADAS_DOM,HEAD_UNIT

BO_ 4137 CLUSTER_Cmd3: 64 CLUSTER
 SG_ DisplayMode : 0|4@1+ (1,0) [0|15] "" GW_CENTRAL,HEAD_UNIT
 SG_ GaugeNeedle_Min : 4|16@1+ (0.1,-1000) [-1000|5553.5] "deg" ADAS_DOM,GW_CENTRAL,HEAD_UNIT
 SG_ TripDist_Raw : 20|16@1+ (0.01,0) [0|655.35] "m" TCU,ADAS_DOM,HEAD_UNIT
 SG_ WarningLampBrake : 36|1@1+ (1,0) [0|1] "" HEAD_UNIT,ADAS_DOM,NAV
 SG_ GaugeNeedle_Avg : 37|16@1+ (0.1,-1000) [-1000|5553.5] "deg" HEAD_UNIT
 SG_ RangeEst_Min : 53|16@1+ (0.01,0) [0|655.35] "m" GW_CENTRAL,HEAD_UNIT
 SG_ AliveCnt : 69|4@1+ (1,0) [0|15] "" HEAD_UNIT,AMP
 SG_ Crc8 : 73|8@1+ (1,0) [0|255] "" HEAD_UNIT,AMP

BO_ 4139 CLUSTER_Info4: 64 CLUSTER
 SG_ ClusterBrightness : 0|8@1+ (0.4,0) [0|102] "%" TCU,ADAS_DOM
 SG_ WarningLampABS : 8|1@1+ (1,0) [0|1] "" GW_CENTRAL,AMP,ADAS_DOM
 SG_ RangeEst : 9|16@1+ (0.01,0) [0|655.35] "m" TCU,GW_CENTRAL,ADAS_DOM
 SG_ TripDist : 25|16@1+ (0.01,0) [0|655.35] "m" AMP,ADAS_DOM
 SG_ RangeEst_Raw : 41|16@1+ (0.01,0) [0|655.35] "m" NAV,AMP,ADAS_DOM
 SG_ ClusterBrightness_Max : 57|8@1+ (0.4,0) [0|102] "%" HEAD_UNIT,ADAS_DOM
 SG_ AliveCnt : 65|4@1+ (1,0) [0|15] "" ADAS_DOM
 SG_ Crc8 : 69|8@1+ (1,0) [0|255] "" ADAS_DOM

BO_ 4147 TCU_Status1: 64 TCU
 SG_ Latitude_Raw : 0|16@1+ (0.1,-1000) [-1000|5553.5] "deg" GW_CENTRAL
 SG_ Latitude_Max : 16|16@1+ (0.1,-1000) [-1000|5553.5] "deg" GW_CENTRAL
 SG_ DataRate_Raw : 32|16@1+ (0.1,0) [0|6553.5] "Hz" ADAS_DOM,GW_CENTRAL
 SG_ OTAProgress : 48|8@1+ (0.4,0) [0|102] "%" HEAD_UNIT,GW_CENTRAL
 SG_ GNSSSpeed_Max : 56|16@1+ (0.01,0) [0|655.35] "km/h" AMP,CLUSTER,GW_CENTRAL
 SG_ SignalStrength_Max : 72|8@1+ (0.4,0) [0|102] "%" AMP,GW_CENTRAL
 SG_ OTAProgress_Min : 80|8@1+ (0.4,0) [0|102] "%" AMP,ADAS_DOM,GW_CENTRAL
 SG_ AliveCnt : 88|4@1+ (1,0) [0|15] "" GW_CENTRAL,CLUSTER
 SG_ Crc8 : 92|8@1+ (1,0) [0|255] "" GW_CENTRAL,CLUSTER

BO_ 4152 TCU_Data2: 64 TCU
 SG_ GNSSSpeed_Avg : 0|16@1+ (0.01,0) [0|655.35] "km/h" NAV,GW_CENTRAL
 SG_ OTAProgress_Raw : 16|8@1+ (0.4,0) [0|102] "%" HEAD_UNIT,GW_CENTRAL,NAV
 SG_ Longitude : 24|16@1+ (0.1,-1000) [-1000|5553.5] "deg" HEAD_UNIT,AMP,NAV,GW_CENTRAL
 SG_ DataRate_Max : 40|16@1+ (0.1,0) [0|6553.5] "Hz" CLUSTER,GW_CENTRAL
 SG_ Longitude_Avg : 56|16@1+ (0.1,-1000) [-1000|5553.5] "deg" CLUSTER,ADAS_DOM,GW_CENTRAL
 SG_ Longitude_Max : 72|16@1+ (0.1,-1000) [-1000|5553.5] "deg" GW_CENTRAL,CLUSTER
 SG_ WifiState : 88|4@1+ (1,0) [0|15] "" NAV,CLUSTER,GW_CENTRAL
 SG_ AliveCnt : 92|4@1+ (1,0) [0|15] "" GW_CENTRAL,HEAD_UNIT,AMP,NAV
 SG_ Crc8 : 96|8@1+ (1,0) [0|255] "" GW_CENTRAL,HEAD_UNIT,AMP,NAV

BO_ 4156 TCU_Cmd3: 64 TCU
 SG_ Latitude : 0|16@1+ (0.1,-1000) [-1000|5553.5] "deg" AMP,NAV,HEAD_UNIT
 SG_ SignalStrength_Raw : 16|8@1+ (0.4,0) [0|102] "%" NAV,ADAS_DOM,HEAD_UNIT
 SG_ GNSSSpeed : 24|16@1+ (0.01,0) [0|655.35] "km/h" GW_CENTRAL,NAV,AMP,HEAD_UNIT
 SG_ DataRate_Avg : 40|16@1+ (0.1,0) [0|6553.5] "Hz" GW_CENTRAL,HEAD_UNIT
 SG_ Latitude_Avg : 56|16@1+ (0.1,-1000) [-1000|5553.5] "deg" ADAS_DOM,HEAD_UNIT
 SG_ SignalStrength : 72|8@1+ (0.4,0) [0|102] "%" NAV,HEAD_UNIT
 SG_ Longitude_Raw : 80|16@1+ (0.1,-1000) [-1000|5553.5] "deg" HEAD_UNIT,GW_CENTRAL
 SG_ Longitude_Min : 96|16@1+ (0.1,-1000) [-1000|5553.5] "deg" CLUSTER,GW_CENTRAL,NAV,HEAD_UNIT
 SG_ AliveCnt : 112|4@1+ (1,0) [0|15] "" HEAD_UNIT,ADAS_DOM
 SG_ Crc8 : 116|8@1+ (1,0) [0|255] "" HEAD_UNIT,ADAS_DOM

BO_ 4161 TCU_Info4: 64 TCU
 SG_ CellularState : 0|4@1+ (1,0) [0|15] "" CLUSTER,ADAS_DOM,AMP
 SG_ GNSSSpeed_Raw : 4|16@1+ (0.01,0) [0|655.35] "km/h" GW_CENTRAL,AMP
 SG_ SignalStrength_Min : 20|8@1+ (0.4,0) [0|102] "%" HEAD_UNIT,AMP
 SG_ DataRate_Min : 28|16@1+ (0.1,0) [0|6553.5] "Hz" CLUSTER,ADAS_DOM,NAV,AMP
 SG_ GNSSFix : 44|4@1+ (1,0) [0|15] "" GW_CENTRAL,HEAD_UNIT,AMP
 SG_ EcallState : 48|4@1+ (1,0) [0|15] "" AMP,HEAD_UNIT,ADAS_DOM
 SG_ GNSSSpeed_Min : 52|16@1+ (0.01,0) [0|655.35] "km/h" CLUSTER,AMP
 SG_ DataRate : 68|16@1+ (0.1,0) [0|6553.5] "Hz" GW_CENTRAL,AMP
 SG_ OTAProgress_Max : 84|8@1+ (0.4,0) [0|102] "%" ADAS_DOM,AMP
 SG_ AliveCnt : 92|4@1+ (1,0) [0|15] "" AMP,CLUSTER
 SG_ Crc8 : 96|8@1+ (1,0) [0|255] "" AMP,CLUSTER

BO_ 4162 TCU_Limits5: 64 TCU
 SG_ OTAProgress_Avg : 0|8@1+ (0.4,0) [0|102] "%" GW_CENTRAL,AMP,NAV
 SG_ Latitude_Min : 8|16@1+ (0.1,-1000) [-1000|5553.5] "deg" HEAD_UNIT,NAV
 SG_ SignalStrength_Avg : 24|8@1+ (0.4,0) [0|102] "%" AMP,HEAD_UNIT,NAV
 SG_ AliveCnt : 32|4@1+ (1,0) [0|15] "" NAV,AMP,CLUSTER
 SG_ Crc8 : 36|8@1+ (1,0) [0|255] "" NAV,AMP,CLUSTER

BO_ 4167 AMP_Status1: 64 AMP
 SG_ EQPreset : 0|4@1+ (1,0) [0|15] "" GW_CENTRAL,HEAD_UNIT
 SG_ ChannelLevel_Raw : 4|8@1+ (0.4,0) [0|102] "%" CLUSTER,NAV,ADAS_DOM,HEAD_UNIT
 SG_ BassLevel_Min : 12|8@1+ (0.4,0) [0|102] "%" TCU,HEAD_UNIT
 SG_ TrebleLevel_Raw : 20|8@1+ (0.4,0) [0|102] "%" CLUSTER,HEAD_UNIT
 SG_ BassLevel_Max : 28|8@1+ (0.4,0) [0|102] "%" NAV,HEAD_UNIT
 SG_ SpeakerFault : 36|1@1+ (1,0) [0|1] "" NAV,ADAS_DOM,HEAD_UNIT
 SG_ BassLevel : 37|8@1+ (0.4,0) [0|102] "%" GW_CENTRAL,HEAD_UNIT
 SG_ OutputPower_Raw : 45|8@1+ (0.4,0) [0|102] "%" NAV,GW_CENTRAL,HEAD_UNIT
 SG_ AliveCnt : 53|4@1+ (1,0) [0|15] "" HEAD_UNIT
 SG_ Crc8 : 57|8@1+ (1,0) [0|255] "" HEAD_UNIT

BO_ 4174 AMP_Data2: 64 AMP
 SG_ OutputPower : 0|8@1+ (0.4,0) [0|102] "%" TCU,HEAD_UNIT
 SG_ AmpTemp_Avg : 8|8@1+ (1,-40) [-40|215] "degC" ADAS_DOM,HEAD_UNIT
 SG_ AmpTemp_Raw : 16|8@1+ (1,-40) [-40|215] "degC" HEAD_UNIT,CLUSTER,TCU
 SG_ OutputPower_Max : 24|8@1+ (0.4,0) [0|102] "%" CLUSTER,HEAD_UNIT
 SG_ AmpTemp : 32|8@1+ (1,-40) [-40|215] "degC" NAV,ADAS_DOM,CLUSTER,HEAD_UNIT
 SG_ BassLevel_Raw : 40|8@1+ (0.4,0) [0|102] "%" NAV,ADAS_DOM,HEAD_UNIT
 SG_ AmpTemp_Min : 48|8@1+ (1,-40) [-40|215] "degC" GW_CENTRAL,CLUSTER,HEAD_UNIT
 SG_ OutputPower_Min : 56|8@1+ (0.4,0) [0|102] "%" ADAS_DOM,TCU,HEAD_UNIT
 SG_ TrebleLevel_Min : 64|8@1+ (0.4,0) [0|102] "%" NAV,ADAS_DOM,HEAD_UNIT
 SG_ AliveCnt : 72|4@1+ (1,0) [0|15] "" HEAD_UNIT,TCU
 SG_ Crc8 : 76|8@1+ (1,0) [0|255] "" HEAD_UNIT,TCU

BO_ 4177 AMP_Cmd3: 64 AMP
 SG_ ChannelLevel_Max : 0|8@1+ (0.4,0) [0|102] "%" GW_CENTRAL,TCU,NAV
 SG_ ChannelLevel : 8|8@1+ (0.4,0) [0|102] "%" CLUSTER,GW_CENTRAL
 SG_ Mute : 16|1@1+ (1,0) [0|1] "" NAV,GW_CENTRAL
 SG_ TrebleLevel : 17|8@1+ (0.4,0) [0|102] "%" TCU,GW_CENTRAL
 SG_ AmpTemp_Max : 25|8@1+ (1,-40) [-40|215] "degC" GW_CENTRAL,TCU,ADAS_DOM
 SG_ OutputPower_Avg : 33|8@1+ (0.4,0) [0|102] "%" TCU,GW_CENTRAL
 SG_ ChannelLevel_Min : 41|8@1+ (0.4,0) [0|102] "%" NAV,GW_CENTRAL
 SG_ ChannelLevel_Avg : 49|8@1+ (0.4,0) [0|102] "%" ADAS_DOM,NAV,GW_CENTRAL
 SG_ AliveCnt : 57|4@1+ (1,0) [0|15] "" GW_CENTRAL,CLUSTER
 SG_ Crc8 : 61|8@1+ (1,0) [0|255] "" GW_CENTRAL,CLUSTER

BO_ 4180 AMP_Info4: 64 AMP
 SG_ TrebleLevel_Max : 0|8@1+ (0.4,0) [0|102] "%" ADAS_DOM,HEAD_UNIT,TCU
 SG_ TrebleLevel_Avg : 8|8@1+ (0.4,0) [0|102] "%" NAV,TCU,GW_CENTRAL
 SG_ BassLevel_Avg : 16|8@1+ (0.4,0) [0|102] "%" CLUSTER,NAV,TCU
 SG_ AliveCnt : 24|4@1+ (1,0) [0|15] "" TCU,NAV
 SG_ Crc8 : 28|8@1+ (1,0) [0|255] "" TCU,NAV

BO_ 4183 AMP_Limits5: 64 AMP
 SG_ AliveCnt : 0|4@1+ (1,0) [0|15] "" TCU
 SG_ Crc8 : 4|8@1+ (1,0) [0|255] "" TCU

BO_ 4186 NAV_Status1: 64 NAV
 SG_ SlopeAhead_Max : 0|16@1+ (0.1,-1000) [-1000|5553.5] "deg" CLUSTER,GW_CENTRAL
 SG_ SpeedLimitMap_Avg : 16|16@1+ (0.01,0) [0|655.35] "km/h" TCU,GW_CENTRAL
 SG_ ETA_Max : 32|16@1+ (0.1,0) [0|6553.5] "s" HEAD_UNIT,AMP,GW_CENTRAL
 SG_ DistToTurn_Min : 48|16@1+ (0.01,0) [0|655.35] "m" HEAD_UNIT,GW_CENTRAL
 SG_ SlopeAhead_Min : 64|16@1+ (0.1,-1000) [-1000|5553.5] "deg" AMP,TCU,GW_CENTRAL
 SG_ DistToTurn : 80|16@1+ (0.01,0) [0|655.35] "m" AMP,TCU,GW_CENTRAL
 SG_ ETA_Avg : 96|16@1+ (0.1,0) [0|6553.5] "s" GW_CENTRAL,TCU
 SG_ AliveCnt : 112|4@1+ (1,0) [0|15] "" GW_CENTRAL,AMP,CLUSTER,ADAS_DOM
 SG_ Crc8 : 116|8@1+ (1,0) [0|255] "" GW_CENTRAL,AMP,CLUSTER,ADAS_DOM

BO_ 4192 NAV_Data2: 64 NAV
 SG_ ETA_Raw : 0|16@1+ (0.1,0) [0|6553.5] "s" TCU,HEAD_UNIT,GW_CENTRAL
 SG_ RoadClass : 16|4@1+ (1,0) [0|15] "" AMP,GW_CENTRAL
 SG_ SlopeAhead_Raw : 20|16@1+ (0.1,-1000) [-1000|5553.5] "deg" ADAS_DOM,TCU,GW_CENTRAL
 SG_ CurvatureAhead_Avg : 36|16@1+ (0.1,-1000) [-1000|5553.5] "deg" AMP,GW_CENTRAL
 SG_ GPSAccuracy_Avg : 52|16@1+ (0.01,0) [0|655.35] "m" AMP,GW_CENTRAL
 SG_ SlopeAhead_Avg : 68|16@1+ (0.1,-1000) [-1000|5553.5] "deg" HEAD_UNIT,AMP,GW_CENTRAL
 SG_ NextManeuver : 84|4@1+ (1,0) [0|15] "" CLUSTER,GW_CENTRAL
 SG_ GPSAccuracy : 88|16@1+ (0.01,0) [0|655.35] "m" CLUSTER,GW_CENTRAL
 SG_ GPSAccuracy_Raw : 104|16@1+ (0.01,0) [0|655.35] "m" TCU,GW_CENTRAL
 SG_ AliveCnt : 120|4@1+ (1,0) [0|15] "" GW_CENTRAL,CLUSTER,HEAD_UNIT
 SG_ Crc8 : 124|8@1+ (1,0) [0|255] "" GW_CENTRAL,CLUSTER,HEAD_UNIT

BO_ 4196 NAV_Cmd3: 64 NAV
 SG_ CurvatureAhead_Max : 0|16@1+ (0.1,-1000) [-1000|5553.5] "deg" GW_CENTRAL,AMP,CLUSTER
 SG_ DistToTurn_Max : 16|16@1+ (0.01,0) [0|655.35] "m" TCU,AMP,CLUSTER
 SG_ SpeedLimitMap_Raw : 32|16@1+ (0.01,0) [0|655.35] "km/h" CLUSTER
 SG_ ETA_Min : 48|16@1+ (0.1,0) [0|6553.5] "s" TCU,CLUSTER
 SG_ CurvatureAhead_Raw : 64|16@1+ (0.1,-1000) [-1000|5553.5] "deg" AMP,ADAS_DOM,GW_CENTRAL,CLUSTER
 SG_ RouteActive : 80|1@1+ (1,0) [0|1] "" CLUSTER
 SG_ AliveCnt : 81|4@1+ (1,0) [0|15] "" CLUSTER,HEAD_UNIT,TCU
 SG_ Crc8 : 85|8@1+ (1,0) [0|255] "" CLUSTER,HEAD_UNIT,TCU

BO_ 4201 NAV_Info4: 64 NAV
 SG_ GPSAccuracy_Max : 0|16@1+ (0.01,0) [0|655.35] "m" HEAD_UNIT,AMP,TCU,GW_CENTRAL
 SG_ SpeedLimitMap : 16|16@1+ (0.01,0) [0|655.35] "km/h" GW_CENTRAL,HEAD_UNIT,CLUSTER
 SG_ SpeedLimitMap_Max : 32|16@1+ (0.01,0) [0|655.35] "km/h" GW_CENTRAL
 SG_ SpeedLimitMap_Min : 48|16@1+ (0.01,0) [0|655.35] "km/h" HEAD_UNIT,AMP,GW_CENTRAL
 SG_ SlopeAhead : 64|16@1+ (0.1,-1000) [-1000|5553.5] "deg" CLUSTER,GW_CENTRAL,HEAD_UNIT
 SG_ GPSAccuracy_Min : 80|16@1+ (0.01,0) [0|655.35] "m" ADAS_DOM,HEAD_UNIT,GW_CENTRAL
 SG_ AliveCnt : 96|4@1+ (1,0) [0|15] "" GW_CENTRAL,AMP,TCU
 SG_ Crc8 : 100|8@1+ (1,0) [0|255] "" GW_CENTRAL,AMP,TCU

BO_ 4209 ADAS_DOM_Status1: 64 ADAS_DOM
 SG_ AEBReq : 0|1@1+ (1,0) [0|1] "" NAV,CLUSTER
 SG_ TargetSpeedRel_Max : 1|16@1+ (0.01,0) [0|655.35] "km/h" NAV,CLUSTER
 SG_ SteerCmd : 17|16@1+ (0.1,-1000) [-1000|5553.5] "deg" NAV,CLUSTER
 SG_ TargetDistance_Raw : 33|16@1+ (0.01,0) [0|655.35] "m" CLUSTER,HEAD_UNIT,GW_CENTRAL
 SG_ FusionConfidence_Raw : 49|8@1+ (0.4,0) [0|102] "%" AMP,TCU,GW_CENTRAL,CLUSTER
 SG_ SpeedLimit_Max : 57|16@1+ (0.01,0) [0|655.35] "km/h" NAV,HEAD_UNIT,CLUSTER
 SG_ TargetSpeedRel_Avg : 73|16@1+ (0.01,0) [0|655.35] "km/h" GW_CENTRAL,CLUSTER
 SG_ FusionConfidence_Min : 89|8@1+ (0.4,0) [0|102] "%" NAV,HEAD_UNIT,CLUSTER
 SG_ DriverAttention_Min : 97|8@1+ (0.4,0) [0|102] "%" HEAD_UNIT,NAV,CLUSTER
 SG_ AliveCnt : 105|4@1+ (1,0) [0|15] "" CLUSTER,TCU
 SG_ Crc8 : 109|8@1+ (1,0) [0|255] "" CLUSTER,TCU

BO_ 4216 ADAS_DOM_Data2: 64 ADAS_DOM
 SG_ TargetSpeedRel_Min : 0|16@1+ (0.01,0) [0|655.35] "km/h" GW_CENTRAL,HEAD_UNIT,TCU
 SG_ TargetDistance_Min : 16|16@1+ (0.01,0) [0|655.35] "m" TCU,AMP,GW_CENTRAL
 SG_ EgoLanePos_Min : 32|16@1+ (0.01,0) [0|655.35] "m" AMP,GW_CENTRAL,NAV
 SG_ ACCSetSpeed_Raw : 48|16@1+ (0.01,0) [0|655.35] "km/h" HEAD_UNIT,GW_CENTRAL
 SG_ ACCSetSpeed : 64|16@1+ (0.01,0) [0|655.35] "km/h" CLUSTER,HEAD_UNIT,GW_CENTRAL
 SG_ LKAReq : 80|1@1+ (1,0) [0|1] "" HEAD_UNIT,CLUSTER,GW_CENTRAL
 SG_ TargetSpeedRel_Raw : 81|16@1+ (0.01,0) [0|655.35] "km/h" HEAD_UNIT,CLUSTER,GW_CENTRAL
 SG_ AliveCnt : 97|4@1+ (1,0) [0|15] "" GW_CENTRAL,AMP,TCU,CLUSTER
 SG_ Crc8 : 101|8@1+ (1,0) [0|255] "" GW_CENTRAL,AMP,TCU,CLUSTER

BO_ 4224 ADAS_DOM_Cmd3: 64 ADAS_DOM
 SG_ DriverAttention_Avg : 0|8@1+ (0.4,0) [0|102] "%" AMP,TCU,CLUSTER
 SG_ ADASState : 8|4@1+ (1,0) [0|15] "" HEAD_UNIT,CLUSTER
 SG_ AEBDecel_Avg : 12|12@1+ (0.05,-100) [-100|104.75] "m/s2" AMP,NAV,GW_CENTRAL,CLUSTER
 SG_ ACCSetSpeed_Avg : 24|16@1+ (0.01,0) [0|655.35] "km/h" CLUSTER,HEAD_UNIT
 SG_ TrafficSign : 40|4@1+ (1,0) [0|15] "" CLUSTER,GW_CENTRAL
 SG_ ACCActive : 44|1@1+ (1,0) [0|1] "" TCU,CLUSTER
 SG_ AliveCnt : 45|4@1+ (1,0) [0|15] "" CLUSTER
 SG_ Crc8 : 49|8@1+ (1,0) [0|255] "" CLUSTER

BO_ 4228 GW_CENTRAL_Status1: 64 GW_CENTRAL
 SG_ SleepRequest : 0|1@1+ (1,0) [0|1] "" HEAD_UNIT,AMP,TCU,CLUSTER
 SG_ VoltageSupply_Max : 1|16@1+ (0.01,0) [0|655.35] "V" ADAS_DOM,HEAD_UNIT,NAV,CLUSTER
 SG_ GatewayTemp_Avg : 17|8@1+ (1,-40) [-40|215] "degC" CLUSTER
 SG_ ErrorCounter : 25|8@1+ (1,0) [0|255] "" AMP,CLUSTER
 SG_ DiagSessionActive : 33|1@1+ (1,0) [0|1] "" AMP,CLUSTER
 SG_ BusLoad : 34|8@1+ (0.4,0) [0|102] "%" AMP,CLUSTER
 SG_ BusLoad_Min : 42|8@1+ (0.4,0) [0|102] "%" TCU,ADAS_DOM,CLUSTER
 SG_ BusLoad_Avg : 50|8@1+ (0.4,0) [0|102] "%" NAV,HEAD_UNIT,CLUSTER
 SG_ AliveCnt : 58|4@1+ (1,0) [0|15] "" CLUSTER,HEAD_UNIT
 SG_ Crc8 : 62|8@1+ (1,0) [0|255] "" CLUSTER,HEAD_UNIT

BO_ 4236 GW_CENTRAL_Data2: 64 GW_CENTRAL
 SG_ TimeSync_Min : 0|16@1+ (0.1,0) [0|6553.5] "s" ADAS_DOM,CLUSTER
 SG_ OTAActive : 16|1@1+ (1,0) [0|1] "" TCU,CLUSTER
 SG_ VoltageSupply : 17|16@1+ (0.01,0) [0|655.35] "V" TCU,HEAD_UNIT,CLUSTER
 SG_ GatewayTemp_Raw : 33|8@1+ (1,-40) [-40|215] "degC" TCU,CLUSTER
 SG_ VoltageSupply_Raw : 41|16@1+ (0.01,0) [0|655.35] "V" HEAD_UNIT,CLUSTER
 SG_ GatewayTemp_Max : 57|8@1+ (1,-40) [-40|215] "degC" HEAD_UNIT,CLUSTER
 SG_ AliveCnt : 65|4@1+ (1,0) [0|15] "" CLUSTER,NAV
 SG_ Crc8 : 69|8@1+ (1,0) [0|255] "" CLUSTER,NAV

BO_ 4237 GW_CENTRAL_Cmd3: 64 GW_CENTRAL
 SG_ GatewayState : 0|4@1+ (1,0) [0|15] "" AMP,NAV,CLUSTER
 SG_ WakeSource : 4|4@1+ (1,0) [0|15] "" TCU,NAV,CLUSTER
 SG_ RoutedFrameCount : 8|8@1+ (1,0) [0|255] "" CLUSTER
 SG_ TimeSync_Avg : 16|16@1+ (0.1,0) [0|6553.5] "s" ADAS_DOM,HEAD_UNIT,TCU,CLUSTER
 SG_ BusLoad_Max : 32|8@1+ (0.4,0) [0|102] "%" CLUSTER,AMP
 SG_ VoltageSupply_Min : 40|16@1+ (0.01,0) [0|655.35] "V" TCU,NAV,CLUSTER
 SG_ NetworkMgmtState : 56|4@1+ (1,0) [0|15] "" CLUSTER
 SG_ AliveCnt : 60|4@1+ (1,0) [0|15] "" CLUSTER,HEAD_UNIT
 SG_ Crc8 : 64|8@1+ (1,0) [0|255] "" CLUSTER,HEAD_UNIT
